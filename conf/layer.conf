## conf/layer.conf
```bitbake
# We have a conf and classes directory, add to BBPATH
BBPATH .= ":${LAYERDIR}"

# We have recipes-* directories, add to BBFILES
BBFILES += "${LAYERDIR}/recipes-*/*/*.bb \
            ${LAYERDIR}/recipes-*/*/*.bbappend"

BBFILE_COLLECTIONS += "meta-mumja"
BBFILE_PATTERN_meta-mumja = "^${LAYERDIR}/"
BBFILE_PRIORITY_meta-mumja = "10"

LAYERDEPENDS_meta-mumja = "core"
LAYERSERIES_COMPAT_meta-mumja = "warrior zeus dunfell"
```
